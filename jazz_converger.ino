
#include "Arduino.h"

// Arduino sketch playing arpeggios generated by LFSR generated polynomials combinations converging to symmetrical fractal jazz chords

#define SPEAKER_PIN 9
#define GENERATE_PIN 2
#define EVOLVE_PIN 3
#define REPEAT_PIN 4
#define KNOB_PIN PIN_A0

// Note frequencies
const float notes_f[] = {
  261.63, 277.18, 293.66, 311.13, 329.63, 349.23, 369.99, 392.00, 415.30, 440.00, 466.16, 493.88,
  523.25, 554.37, 587.33, 622.25, 659.26, 698.46, 739.99, 783.99, 830.61, 880.00, 932.33, 987.77
};

#define NOTE_DURATION 100
#define LFSR_SEED 0xACE1
#define LFSR_MASK 0xB400
#define POLY_COUNT 3
#define ITER_COUNT 8
#define PROG_COUNT 4

// Jazz ii-V-I-vi progression in C Major
// Dm7, G7, Cmaj7, Am7
const float jazz_progression[PROG_COUNT][4] = {
  {293.66, 349.23, 440.00, 523.25}, // Dm7 (D4, F4, A4, C5)
  {392.00, 493.88, 587.33, 698.46}, // G7 (G4, B4, D5, F5)
  {261.63, 329.63, 392.00, 493.88}, // Cmaj7 (C4, E4, G4, B4)
  {440.00, 523.25, 659.26, 783.99}  // Am7 (A4, C5, E5, G5)
};

uint16_t lfsr = LFSR_SEED;
uint16_t polys[POLY_COUNT];
uint16_t notes[POLY_COUNT];
uint8_t currentProgStep = 0;

uint8_t lfsr_bit() {
  lfsr >>= 1;
  if (lfsr & 1) {
    lfsr ^= LFSR_MASK;
    return 1;
  }
  return 0;
}

uint16_t lfsr_note() {
  uint8_t index = 0;
  for(int i=0; i<4; i++) index |= (lfsr_bit() << i);
  return (uint16_t)notes_f[index % 24];
}

uint16_t lfsr_poly() {
  uint16_t poly = 0;
  for (int i=0; i<8; i++) poly |= (lfsr_bit() << i);
  return poly;
}

uint16_t eval_poly(uint16_t poly, uint16_t note) { 
   uint32_t z = note;
   uint32_t c = poly;
   for (uint8_t i = 0; i < 3; i++) {
      z = (z * z) % 1000;
      z = (z + c) % 1000;
   } 
   return (uint16_t)(z + 100);
}

void play_note(uint16_t frequency, uint16_t duration) { 
   tone(SPEAKER_PIN, frequency, duration);
   delay(duration); 
   noTone(SPEAKER_PIN);
}

void play_arpeggio(uint16_t poly, uint16_t note) {
  uint16_t seq[ITER_COUNT];
  uint16_t current = note;
  for (uint8_t i = 0; i < ITER_COUNT; i++) {
    seq[i] = current;
    current = eval_poly(poly, current);
  }
  for (uint8_t i = 0; i < ITER_COUNT; i++) play_note(seq[i], NOTE_DURATION);
  for (int8_t i = ITER_COUNT - 2; i >= 0; i--) play_note(seq[i], NOTE_DURATION);
}

void play_fractal(uint16_t polys_arr[], uint16_t notes_arr[]) {
  uint16_t sum = 0;
  for (uint8_t i = 0; i < POLY_COUNT; i++) sum += eval_poly(polys_arr[i], notes_arr[i]);
  play_note(sum, NOTE_DURATION * 4);
}

void generate_sequence() {
  for (uint8_t i = 0; i < POLY_COUNT; i++) {
    polys[i] = lfsr_poly();
    notes[i] = lfsr_note();
  }
}

// Converge toward the current step of the jazz progression
void evolve_sequence() {
  for (uint8_t i = 0; i < POLY_COUNT; i++) {
    uint16_t current_val = eval_poly(polys[i], notes[i]);
    
    // Find nearest frequency in the current chord of the progression
    float min_diff = 10000;
    float target = 0;
    for(int t=0; t<4; t++) {
        float d = abs(jazz_progression[currentProgStep][t] - (float)current_val);
        if (d < min_diff) {
            min_diff = d;
            target = jazz_progression[currentProgStep][t];
        }
    }

    for (int b = 0; b < 8; b++) {
      uint16_t next_poly = polys[i] ^ (1 << b);
      uint16_t next_val = eval_poly(next_poly, notes[i]);
      float next_diff = abs(target - (float)next_val);
      if (next_diff < min_diff) {
        polys[i] = next_poly;
        min_diff = next_diff;
      }
    }
  }
}

void play_sequence() {
  for (uint8_t j = 0; j < POLY_COUNT; j++) play_arpeggio(polys[j], notes[j]);
  play_fractal(polys, notes);
  for (uint8_t j = 0; j < POLY_COUNT; j++) notes[j] = eval_poly(polys[j], notes[j]);
}

void set_target() {
  uint16_t value = analogRead(KNOB_PIN);
  // Map knob to progression step
  currentProgStep = map(value, 0, 1023, 0, PROG_COUNT - 1);
  digitalWrite(LED_BUILTIN, (currentProgStep == 0) ? HIGH : LOW);
}

void setup() {
  pinMode(SPEAKER_PIN, OUTPUT);
  pinMode(GENERATE_PIN, INPUT_PULLUP);
  pinMode(EVOLVE_PIN, INPUT_PULLUP);
  pinMode(REPEAT_PIN, INPUT_PULLUP);
  pinMode(KNOB_PIN, INPUT);
  pinMode(LED_BUILTIN, OUTPUT);
  Serial.begin(9600);
}

void loop() {
  set_target();
  if (digitalRead(GENERATE_PIN) == LOW) {
    generate_sequence();
    play_sequence();
    delay(500);
  }
  if (digitalRead(EVOLVE_PIN) == LOW) {
    evolve_sequence();
    play_sequence();
    delay(500);
  }
  if (digitalRead(REPEAT_PIN) == LOW) {
    play_sequence();
    delay(500);
  }
}
