
#include "Arduino.h"

// Arduino sketch playing arpeggios generated by LFSR generated polynomials combinations forming symmetrical fractal melodies

#define SPEAKER_PIN 9
#define GENERATE_PIN 2
#define EVOLVE_PIN 3
#define REPEAT_PIN 4

#define C4 262
#define D4 294
#define E4 330
#define F4 349
#define G4 392
#define A4 440
#define B4 494
#define C5 523

#define NOTE_DURATION 100
#define LFSR_SEED 0xACE1
#define LFSR_MASK 0xB400
#define POLY_COUNT 3
#define ITER_COUNT 8

uint16_t lfsr = LFSR_SEED;
uint16_t polys[POLY_COUNT];
uint16_t notes[POLY_COUNT];
uint16_t freqs_arr[] = {C4, D4, E4, F4, G4, A4, B4, C5};

uint8_t lfsr_bit() {
  lfsr >>= 1;
  if (lfsr & 1) {
    lfsr ^= LFSR_MASK;
    return 1;
  }
  return 0;
}

uint16_t lfsr_note() {
  uint8_t index = 0;
  for(int i=0; i<3; i++) index |= (lfsr_bit() << i);
  return freqs_arr[index % 8];
}

uint16_t lfsr_poly() {
  uint16_t poly = 0;
  for (int i=0; i<8; i++) poly |= (lfsr_bit() << i);
  return poly;
}

uint16_t eval_poly(uint16_t poly, uint16_t note) { 
   uint32_t z = note;
   uint32_t c = poly;
   for (uint8_t i = 0; i < 3; i++) {
      z = (z * z) % 800;
      z = (z + c) % 800;
   } 
   return (uint16_t)(z + 150);
}

void play_note(uint16_t frequency, uint16_t duration) { 
   tone(SPEAKER_PIN, frequency, duration);
   delay(duration); 
   noTone(SPEAKER_PIN);
}

void play_arpeggio(uint16_t poly, uint16_t note) {
  uint16_t seq[ITER_COUNT];
  uint16_t current = note;
  for (uint8_t i = 0; i < ITER_COUNT; i++) {
    seq[i] = current;
    current = eval_poly(poly, current);
  }
  for (uint8_t i = 0; i < ITER_COUNT; i++) play_note(seq[i], NOTE_DURATION);
  for (int8_t i = ITER_COUNT - 2; i >= 0; i--) play_note(seq[i], NOTE_DURATION);
}

void play_fractal(uint16_t polys_arr[], uint16_t notes_arr[]) {
  uint16_t sum = 0;
  for (uint8_t i = 0; i < POLY_COUNT; i++) sum += eval_poly(polys_arr[i], notes_arr[i]);
  play_note(sum, NOTE_DURATION * 4);
}

void generate_sequence() {
  for (uint8_t i = 0; i < POLY_COUNT; i++) {
    polys[i] = lfsr_poly();
    notes[i] = lfsr_note();
  }
}

void evolve_sequence() {
  // Simple melody evolution: hill climbing to find "melodic" intervals
  for (uint8_t i = 0; i < POLY_COUNT; i++) {
    uint16_t current_val = eval_poly(polys[i], notes[i]);
    // Target: a harmonic relative of the seed note (e.g. perfect fifth)
    uint32_t target = (notes[i] * 3) / 2;
    if (target > 1000) target /= 2;

    float min_diff = abs((float)target - (float)current_val);
    for (int b = 0; b < 8; b++) {
      uint16_t next_poly = polys[i] ^ (1 << b);
      uint16_t next_val = eval_poly(next_poly, notes[i]);
      float next_diff = abs((float)target - (float)next_val);
      if (next_diff < min_diff) {
        polys[i] = next_poly;
        min_diff = next_diff;
      }
    }
  }
}

void play_sequence() {
  for (uint8_t j = 0; j < POLY_COUNT; j++) play_arpeggio(polys[j], notes[j]);
  play_fractal(polys, notes);
  for (uint8_t j = 0; j < POLY_COUNT; j++) notes[j] = eval_poly(polys[j], notes[j]);
}

void setup() {
  pinMode(SPEAKER_PIN, OUTPUT);
  pinMode(GENERATE_PIN, INPUT_PULLUP);
  pinMode(EVOLVE_PIN, INPUT_PULLUP);
  pinMode(REPEAT_PIN, INPUT_PULLUP);
  Serial.begin(9600);
}

void loop() {
  if (digitalRead(GENERATE_PIN) == LOW) {
    generate_sequence();
    play_sequence();
    delay(500);
  }
  if (digitalRead(EVOLVE_PIN) == LOW) {
    evolve_sequence();
    play_sequence();
    delay(500);
  }
  if (digitalRead(REPEAT_PIN) == LOW) {
    play_sequence();
    delay(500);
  }
}
