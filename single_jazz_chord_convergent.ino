
#include "Arduino.h"

// Arduino sketch playing arpeggios generated by LFSR generated polynomials combinations converging to symmetrical fractal chords

// Define the pins for the speaker and the buttons
#define SPEAKER_PIN 9
#define GENERATE_PIN 2 // Button to generate a new sequence
#define EVOLVE_PIN 3 // Button to evolve the current sequence
#define REPEAT_PIN 4 // Button to repeat the current sequence

// Define the notes and frequencies for the arpeggios
#define C4 262
#define E4 330
#define G4 392
#define B4 494
#define C5 523

// Define the duration of each note in milliseconds
#define NOTE_DURATION 100

// Define the LFSR parameters
#define LFSR_SEED 0xACE1
#define LFSR_MASK 0xB400

// Define the number of polynomials to combine
#define POLY_COUNT 3

// Define the number of iterations for the fractal generation
#define ITER_COUNT 8

// Define a Cmaj7 target chord
const uint16_t target_chord[] = {C4, E4, G4, B4};
#define TARGET_COUNT 4

// Global LFSR state
uint16_t lfsr = LFSR_SEED;

// LFSR and note arrays
uint16_t polys[POLY_COUNT];
uint16_t notes[POLY_COUNT];

// Available frequencies for seeding
uint16_t freqs_arr[] = {262, 294, 330, 349, 392, 440, 494, 523};

// LFSR bit generator
uint8_t lfsr_bit() {
  lfsr >>= 1;
  if (lfsr & 1) {
    lfsr ^= LFSR_MASK;
    return 1;
  }
  return 0;
}

// LFSR note generator
uint16_t lfsr_note() {
  uint8_t index = 0;
  index += lfsr_bit();
  index += lfsr_bit() << 1;
  index += lfsr_bit() << 2;
  return freqs_arr[index % 8];
}

// LFSR polynomial generator
uint16_t lfsr_poly() {
  uint16_t poly = 0;
  for (int i=0; i<8; i++) {
    poly |= (lfsr_bit() << i);
  }
   return poly; 
}

// Mandelbrot-style fractal iteration: z(n+1) = z(n)^2 + c
// Keeps values in a musically useful range [100, 1000] Hz.
uint16_t eval_poly(uint16_t poly, uint16_t note) { 
   uint32_t z = note;
   uint32_t c = poly;
   // 3 iterations per call to create fractal-like self-similarity
   for (uint8_t i = 0; i < 3; i++) {
      z = (z * z) % 900; // Modulo to stay within a range
      z = (z + c) % 900;
   } 
   return (uint16_t)(z + 100);
}

void play_note(uint16_t frequency, uint16_t duration) { 
   tone(SPEAKER_PIN, frequency, duration);
   delay(duration); 
   noTone(SPEAKER_PIN);
}

// Symmetrical arpeggio (forward and backward)
void play_arpeggio(uint16_t poly, uint16_t note) {
  uint16_t seq[ITER_COUNT];
  uint16_t current = note;
  for (uint8_t i = 0; i < ITER_COUNT; i++) {
    seq[i] = current;
    current = eval_poly(poly, current);
  }
  // Play forward
  for (uint8_t i = 0; i < ITER_COUNT; i++) {
    play_note(seq[i], NOTE_DURATION);
  }
  // Play backward
  for (int8_t i = ITER_COUNT - 2; i >= 0; i--) {
    play_note(seq[i], NOTE_DURATION);
  }
}

// Play chord sum
void play_fractal(uint16_t polys_arr[], uint16_t notes_arr[]) {
  uint16_t sum = 0;
  for (uint8_t i = 0; i < POLY_COUNT; i++) {
    sum += eval_poly(polys_arr[i], notes_arr[i]);
  }
  play_note(sum, NOTE_DURATION * 4);
}

// Generate new random parameters
void generate_sequence() {
  for (uint8_t i = 0; i < POLY_COUNT; i++) {
    polys[i] = lfsr_poly();
    notes[i] = lfsr_note();
  }
}

// Optimize polynomials toward matching chord frequencies
void evolve_sequence() {
  for (uint8_t i = 0; i < POLY_COUNT; i++) {
    uint16_t current_val = eval_poly(polys[i], notes[i]);

    // Find nearest frequency in the target chord
    uint16_t target = target_chord[0];
    uint16_t min_diff = abs((int)target - (int)current_val);
    for(int t=1; t<TARGET_COUNT; t++) {
        uint16_t d = abs((int)target_chord[t] - (int)current_val);
        if (d < min_diff) {
            min_diff = d;
            target = target_chord[t];
        }
    }
    
    // Iteratively flip bits to minimize distance to target
    for (int b = 0; b < 8; b++) {
      uint16_t next_poly = polys[i] ^ (1 << b);
      uint16_t next_val = eval_poly(next_poly, notes[i]);
      uint16_t next_diff = abs((int)target - (int)next_val);
      if (next_diff < min_diff) {
        polys[i] = next_poly;
        min_diff = next_diff;
      }
    }
  }
}

// Play current sequence
void play_sequence() {
  for (uint8_t j = 0; j < POLY_COUNT; j++) {
    play_arpeggio(polys[j], notes[j]);
  }
  play_fractal(polys, notes);
  // Iteratively update notes for the next loop
  for (uint8_t j = 0; j < POLY_COUNT; j++) {
    notes[j] = eval_poly(polys[j], notes[j]);
  }
}

void setup() {
  pinMode(SPEAKER_PIN, OUTPUT);
  pinMode(GENERATE_PIN, INPUT_PULLUP);
  pinMode(EVOLVE_PIN, INPUT_PULLUP);
  pinMode(REPEAT_PIN, INPUT_PULLUP);
  Serial.begin(9600);
}

void loop() {
  if (digitalRead(GENERATE_PIN) == LOW) {
    generate_sequence();
    play_sequence();
    delay(500);
  }
  if (digitalRead(EVOLVE_PIN) == LOW) {
    evolve_sequence();
    play_sequence();
    delay(500);
  }
  if (digitalRead(REPEAT_PIN) == LOW) {
    play_sequence();
    delay(500);
  }
}
